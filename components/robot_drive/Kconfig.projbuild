## components/robot_drive/Kconfig.projbuild
```kconfig
menu "Robot drive dry-run configuration"

    config ROBOT_DRIVE_CONTROL_PERIOD_MS
        int "Dry-run control period (ms)"
        range 5 100
        default 10
        help
            Period used by the FreeRTOS task that evaluates the newest command.
            This is scheduling configuration, not a measured motor-control period.

    config ROBOT_DRIVE_COMMAND_TIMEOUT_MS
        int "Command timeout (ms)"
        range 50 5000
        default 500
        help
            A command older than this is replaced by a zero-target snapshot.

    config ROBOT_DRIVE_TURN_GEOMETRY_MM
        int "Effective turn geometry (mm)"
        range 1 2000
        default 115
        help
            Provisional effective turn coefficient inherited from the PC model.
            It must not be presented as a measured chassis half-track. Measure
            or identify the real geometry before connecting physical motors.

    config ROBOT_DRIVE_MAX_TARGET_MMPS
        int "Maximum wheel target (mm/s)"
        range 1 10000
        default 1000
        help
            Common scaling keeps the left-to-right target ratio while limiting
            every wheel. This is not a verified physical speed limit.

    config ROBOT_DRIVE_TASK_STACK
        int "Dry-run task stack size (bytes)"
        range 2048 16384
        default 4096

    config ROBOT_DRIVE_TASK_PRIORITY
        int "Dry-run task priority"
        range 1 24
        default 6

endmenu
```

## components/robot_imu/Kconfig.projbuild
```kconfig
menu "Robot IMU Configuration"

    choice ROBOT_IMU_BACKEND
        prompt "IMU data backend"
        default ROBOT_IMU_BACKEND_DISABLED
        help
            Select the source that produces SI-unit IMU samples. Keep the
            backend disabled until the physical sensor model and wiring have
            been confirmed. The synthetic backend is only for software and
            ESP32 data-chain tests; it is not sensor evidence.

        config ROBOT_IMU_BACKEND_DISABLED
            bool "Disabled"

        config ROBOT_IMU_BACKEND_SYNTHETIC
            bool "Synthetic samples (test only)"

        config ROBOT_IMU_BACKEND_ICM42670P
            bool "ICM42670P on I2C0 (GPIO39/GPIO40)"
            help
                Physical ICM42670P backend validated for address 0x68 at
                400 kHz. Samples remain in the sensor-native right-handed
                frame; the installation transform to the robot base must be
                validated separately.
    endchoice

    config ROBOT_IMU_SYNTHETIC_PERIOD_MS
        int "Synthetic sample period (ms)"
        range 1 1000
        default 10
        depends on ROBOT_IMU_BACKEND_SYNTHETIC

    config ROBOT_IMU_STALE_TIMEOUT_MS
        int "Maximum sample age before it is stale (ms)"
        range 1 5000
        default 100
        help
            The ROS publisher may use this threshold to reject old samples.
            Publishing a sample must never refresh its acquisition timestamp.

endmenu
```

## components/robot_microros/Kconfig.projbuild
```kconfig
menu "Robot micro-ROS Configuration"

    config ROBOT_MICROROS_AGENT_IP
        string "micro-ROS Agent IPv4 address"
        default ""

    config ROBOT_MICROROS_AGENT_PORT
        string "micro-ROS Agent UDP port"
        default "8888"

    config ROBOT_MICROROS_DOMAIN_ID
        int "ROS 2 domain ID"
        range 0 101
        default 0

    config ROBOT_MICROROS_PUBLISH_PERIOD_MS
        int "Heartbeat publish period (ms)"
        range 100 10000
        default 1000

    config ROBOT_MICROROS_IMU_PUBLISH_PERIOD_MS
        int "IMU publish period (ms)"
        range 10 1000
        default 10
        help
            This controls ROS message publication, not the sensor sampling rate.

    config ROBOT_MICROROS_TIME_SYNC_PERIOD_MS
        int "Agent time resynchronization period (ms)"
        range 5000 3600000
        default 60000
        help
            IMU messages are withheld until Agent epoch time is synchronized.

    config ROBOT_MICROROS_TASK_STACK
        int "micro-ROS task stack size (bytes)"
        range 8192 32768
        default 16000

    config ROBOT_MICROROS_TASK_PRIORITY
        int "micro-ROS task priority"
        range 1 24
        default 5

endmenu
```

## sdkconfig.defaults
```kconfig
CONFIG_ESPTOOLPY_FLASHMODE_DIO=y
CONFIG_ESPTOOLPY_FLASHFREQ_40M=y
CONFIG_ESPTOOLPY_FLASHFREQ="40m"
CONFIG_ESPTOOLPY_FLASHSIZE_4MB=y
CONFIG_ESPTOOLPY_FLASHSIZE="4MB"
CONFIG_FREERTOS_HZ=1000
```

## src/Kconfig.projbuild
```kconfig
menu "Robot Application Mode"

    choice ROBOT_APP_MODE
        prompt "Application mode"
        default ROBOT_APP_MODE_NORMAL

        config ROBOT_APP_MODE_NORMAL
            bool "Normal robot application"

        config ROBOT_APP_MODE_ENCODER_PROBE
            bool "Read-only four-channel encoder probe"

        config ROBOT_APP_MODE_CHASSIS_DIAG
            bool "Default-disarmed chassis diagnostic"

        config ROBOT_APP_MODE_MICROROS_CHASSIS
            bool "Default-disarmed micro-ROS chassis integration"
    endchoice

endmenu

menu "Robot Network Configuration"

    config ROBOT_WIFI_SSID
        string "Wi-Fi SSID"
        default ""

    config ROBOT_WIFI_PASSWORD
        string "Wi-Fi password"
        default ""

    config ROBOT_WIFI_MAXIMUM_RETRY
        int "Maximum retry count"
        range 1 20
        default 10

endmenu
```
